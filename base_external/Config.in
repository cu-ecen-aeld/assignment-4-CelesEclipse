## base_external/Config.in
```kconfig
# Config.in for the base_external directory
source "/home/milady/coursera_linux_2/assignment-4-CelesEclipse/base_external/package/aesd-assignments/Config.in"
```
